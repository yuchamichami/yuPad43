## firmware/xiao-example/west.yml
```yaml
manifest:
  remotes:
    - name: zmkfirmware
      url-base: https://github.com/zmkfirmware
  projects:
    - name: zmk
      remote: zmkfirmware
      revision: v0.3.0
      import: app/west.yml
    - name: zmk-driver-yupad43
      url: https://github.com/yuchamichami/zmk-driver-yupad43
      revision: 9c6ea0e78ca846edba9abe8c82b52073003f8261
  self:
    path: zmk-yupad43-config
```
