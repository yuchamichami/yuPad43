## firmware/xiao-example/west.yml
```yaml
manifest:
  remotes:
    - name: zmkfirmware
      url-base: https://github.com/zmkfirmware
  projects:
    - name: zmk
      remote: zmkfirmware
      revision: v0.3.0
      import: app/west.yml
    - name: zmk-driver-yupad43
      url: https://github.com/yuchamichami/zmk-driver-yupad43
      revision: 5dfa6d3c480ebb5162f5425fa367823d73ddb13e
  self:
    path: zmk-yupad43-config
```
